#include "ssd1306.h"
#include "stm32f7xx_hal.h"
#include <string.h>

/* -------------------------------------------------------------------------- */
/* Hardware Register Definitions (STM32F746)                                  */
/* -------------------------------------------------------------------------- */
#define RCC_BASE_ADDR        0x40023800U
#define AHB1ENR              (*(volatile uint32_t *)(RCC_BASE_ADDR + 0x30U))
#define APB2ENR              (*(volatile uint32_t *)(RCC_BASE_ADDR + 0x44U))

#define GPIOA_BASE_ADDR      0x40020000U
#define GPIOA_MODER          (*(volatile uint32_t *)(GPIOA_BASE_ADDR + 0x00U))
#define GPIOA_AFRL           (*(volatile uint32_t *)(GPIOA_BASE_ADDR + 0x20U))

#define GPIOD_BASE_ADDR      0x40020C00U
#define GPIOD_MODER          (*(volatile uint32_t *)(GPIOD_BASE_ADDR + 0x00U))
#define GPIOD_ODR            (*(volatile uint32_t *)(GPIOD_BASE_ADDR + 0x14U))

#define GPIOF_BASE_ADDR      0x40021400U
#define GPIOF_MODER          (*(volatile uint32_t *)(GPIOF_BASE_ADDR + 0x00U))
#define GPIOF_ODR            (*(volatile uint32_t *)(GPIOF_BASE_ADDR + 0x14U))

#define SPI1_BASE_ADDR       0x40013000U
#define SPI1_CR1             (*(volatile uint32_t *)(SPI1_BASE_ADDR + 0x00U))
#define SPI1_CR2             (*(volatile uint32_t *)(SPI1_BASE_ADDR + 0x04U))
#define SPI1_SR              (*(volatile uint32_t *)(SPI1_BASE_ADDR + 0x08U))
#define SPI1_DR              (*(volatile uint32_t *)(SPI1_BASE_ADDR + 0x0CU))

#define CS_LOW()             (GPIOD_ODR &= ~(1U << 14)) // PD14 (Arduino D10)
#define CS_HIGH()            (GPIOD_ODR |= (1U << 14))

#define DC_COMMAND()         (GPIOD_ODR &= ~(1U << 15)) // PD15 (Arduino D9)
#define DC_DATA()            (GPIOD_ODR |= (1U << 15))

#define RESET_LOW()          (GPIOF_ODR &= ~(1U << 12)) // PF12
#define RESET_HIGH()         (GPIOF_ODR |= (1U << 12))

/* -------------------------------------------------------------------------- */
/* Font Tables                                                                */
/* -------------------------------------------------------------------------- */

// 5x7 ASCII font (Font Size 1: Small)
static const uint8_t Font5x7[][5] = {
    {0x00, 0x00, 0x00, 0x00, 0x00}, // Space
    {0x00, 0x00, 0x5F, 0x00, 0x00}, // !
    {0x00, 0x07, 0x00, 0x07, 0x00}, // "
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    {0x61, 0x51, 0x49, 0x45, 0x43}  // Z
};

// 16x16 CGA16 font (Font Size 2: Large)[cite: 7]
static const uint8_t CGA16[] = {
    0x00,0x00,0x00,0x00,0x00,0x00,0x00,0x00,0x00,0x00,0x00,0x00,0x00,0x00,0x00,0x00,0x00,0x00,0x00,0x00,0x00,0x00,0x00,0x00,0x00,0x00,0x00,0x00,0x00,0x00,0x00,0x00,
    0x0F,0x00,0x0F,0x00,0x3F,0xC0,0x3F,0xC0,0x3F,0xC0,0x3F,0xC0,0x0F,0x00,0x0F,0x00,0x0F,0x00,0x0F,0x00,0x00,0x00,0x00,0x00,0x0F,0x00,0x0F,0x00,0x00,0x00,0x00,0x00,
    0x3C,0xF0,0x3C,0xF0,0x3C,0xF0,0x3C,0xF0,0x3C,0xF0,0x3C,0xF0,0x00,0x00,0x00,0x00,0x00,0x00,0x00,0x00,0x00,0x00,0x00,0x00,0x00,0x00,0x00,0x00,0x00,0x00,0x00,0x00,
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    0xFF,0xFC,0xFF,0xFC,0xF0,0x3C,0xF0,0x3C,0xC0,0xF0,0xC0,0xF0,0x03,0xC0,0x03,0xC0,0x0F,0x0C,0x0F,0x0C,0x3C,0x3C,0x3C,0x3C,0xFF,0xFC,0xFF,0xFC,0x00,0x00,0x00,0x00
};

static uint8_t FRAME_BUFFER[SSD1306_FB_SIZE] = {0};

/* -------------------------------------------------------------------------- */
/* Low-Level SPI & GPIO Driver Functions                                      */
/* -------------------------------------------------------------------------- */
static void send_spi_data(uint8_t *Data, uint32_t length) {
    while (length > 0) {
        while (!(SPI1_SR & (1U << 1))); // Wait until TXE is empty[cite: 11]
        *(volatile uint8_t *)(&SPI1_DR) = *Data; // 8-bit pointer write prevents FIFO packing[cite: 11]
        Data++;
        length--;
    }
    while (!(SPI1_SR & (1U << 1)));
    while (SPI1_SR & (1U << 7)); // Wait until BSY flag clears[cite: 11]
}

static void send_command(uint8_t command) {
    DC_COMMAND();
    CS_LOW();
    SPI1_CR1 |= (1U << 6); // Enable SPI[cite: 11]
    send_spi_data(&command, 1);
    SPI1_CR1 &= ~(1U << 6); // Disable SPI[cite: 11]
    CS_HIGH();
}

static void send_data(uint8_t *data, uint32_t length) {
    DC_DATA();
    CS_LOW();
    SPI1_CR1 |= (1U << 6); // Enable SPI[cite: 11]
    send_spi_data(data, length);
    SPI1_CR1 &= ~(1U << 6); // Disable SPI[cite: 11]
    CS_HIGH();
}

/* -------------------------------------------------------------------------- */
/* Framebuffer Pixel Operations                                               */
/* -------------------------------------------------------------------------- */
static void set_pixel(int x, int y, bool state) {
    if (x < 0 || x >= (int)SSD1306_WIDTH || y < 0 || y >= (int)SSD1306_HEIGHT) return;
    int pos = SSD1306_WIDTH * (y / 8) + x;
    if (state) {
        FRAME_BUFFER[pos] |= (1 << (y % 8));
    } else {
        FRAME_BUFFER[pos] &= ~(1 << (y % 8));
    }
}

static void draw_bitmap_16x16(int x, int y, const uint8_t *bitmap) {
    int size = 32; // (16 * 16) / 8
    int OGX = x;
    int OGY = y;

    for (int i = 0; i < size; i++) {
        for (int j = 0; j < 8; j++) {
            uint8_t chkMsk = 0x80 >> j;
            set_pixel(x, y, (bitmap[i] & chkMsk) != 0);
            x++;

            if ((x - OGX) == 16) {
                y++;
                x = OGX;
            }
            if ((y - OGY) == 16 || y >= (int)SSD1306_HEIGHT) {
                return;
            }
        }
    }
}

static void draw_char_5x7(int x, int y, char c) {
    if (c < ' ' || c > 'Z') return;
    const uint8_t *glyph = Font5x7[c - ' '];

    for (int col = 0; col < 5; col++) {
        uint8_t line = glyph[col];
        for (int row = 0; row < 7; row++) {
            set_pixel(x + col, y + row, (line & (1 << row)) != 0);
        }
    }
}

/* -------------------------------------------------------------------------- */
/* Public API Functions                                                       */
/* -------------------------------------------------------------------------- */
void ssd1306_init(void) {
    /* 1. Enable Clocks for GPIOA, GPIOD, GPIOF */
    AHB1ENR |= (1U << 0); // GPIOA[cite: 11]
    AHB1ENR |= (1U << 3); // GPIOD[cite: 6, 11]
    AHB1ENR |= (1U << 5); // GPIOF[cite: 6]

    /* 2. Configure PA5 (SCK), PA7 (MOSI) as AF5 (SPI1) */
    GPIOA_MODER &= ~((3U << 10) | (3U << 14));
    GPIOA_MODER |=  ((2U << 10) | (2U << 14));
    GPIOA_AFRL  &= ~((0xFU << 20) | (0xFU << 28));
    GPIOA_AFRL  |=  ((5U << 20) | (5U << 28));

    /* 3. Configure PD14 (CS), PD15 (DC) as Output */
    GPIOD_MODER &= ~((3U << 28) | (3U << 30));
    GPIOD_MODER |=  ((1U << 28) | (1U << 30));

    /* 4. Configure PF12 (Reset) as Output */
    GPIOF_MODER &= ~(3U << 24);
    GPIOF_MODER |=  (1U << 24);

    CS_HIGH();

    /* 5. SPI1 Initialization (APB2 = 108MHz / 16 = 6.75MHz SPI clock) */
    APB2ENR |= (1U << 12);
    SPI1_CR1 = 0;
    SPI1_CR2 = 0;
    SPI1_CR2 |= (7U << 8);              // 8-bit frame
    SPI1_CR2 |= (1U << 12);             // 8-bit FIFO threshold
    SPI1_CR1 |= (1U << 2);              // Master mode
    SPI1_CR1 |= (3U << 3);              // Prescaler /16
    SPI1_CR1 |= (1U << 9) | (1U << 8);  // SSM, SSI

    /* 6. Hardware Reset (Hardware Timer backed) */
    RESET_LOW();
    HAL_Delay(20);
    RESET_HIGH();
    HAL_Delay(20);

    /* 7. SSD1306 Init Sequence */
    send_command(0xAE);
    send_command(0xD5);
    send_command(0x80);
    send_command(0xA8);
    send_command(0x3F);
    send_command(0xD3);
    send_command(0x00);
    send_command(0x40 | 0x00);
    send_command(0x8D);
    send_command(0x14); // Enable Charge Pump
    send_command(0x20);
    send_command(0x00); // Horizontal mode
    send_command(0xA0 | 0x01);
    send_command(0xC8);
    send_command(0xDA);
    send_command(0x12);
    send_command(0x81);
    send_command(0xCF);
    send_command(0xD9);
    send_command(0xF1);
    send_command(0xDB);
    send_command(0x40);
    send_command(0xA4);
    send_command(0xA6);
    send_command(0x2E);
    send_command(0xAF); // Display ON

    ssd1306_clear();
    ssd1306_update();
}

void ssd1306_clear(void) {
    memset(FRAME_BUFFER, 0x00, sizeof(FRAME_BUFFER));
}

void ssd1306_update(void) {
    send_command(0x21); // Column Address
    send_command(0);
    send_command(127);

    send_command(0x22); // Page Address
    send_command(0);
    send_command(7);

    send_data(FRAME_BUFFER, SSD1306_FB_SIZE);
}

void ssd1306_draw_text(int x, int y, int font_size, const char *text) {
    int runningX = x;
    int runningY = y;
    size_t len = strlen(text);

    if (font_size == FONT_LARGE) {
        // 16x16 CGA16 font (Upper-case and symbols: Space to 'Z')
        for (size_t i = 0; i < len; i++) {
            if (runningX + 16 > (int)SSD1306_WIDTH) {
                runningX = x;
                runningY += 16;
            }
            if (runningY >= (int)SSD1306_HEIGHT) return;

            char ch = text[i];

            // Map lowercase to uppercase so it indexes valid CGA16 glyphs
            if (ch >= 'a' && ch <= 'z') {
                ch -= 32;
            }

            if (ch >= ' ' && ch <= 'Z') {
                int target = 32 * (ch - ' ');
                const uint8_t *drawChar = CGA16 + target;
                draw_bitmap_16x16(runningX, runningY, drawChar);
            }
            runningX += 16;
        }
    } else {
        // FONT_SMALL: 5x7 glyph with 1px space (6x8 total footprint)
        for (size_t i = 0; i < len; i++) {
            if (runningX + 6 > (int)SSD1306_WIDTH) {
                runningX = x;
                runningY += 9;
            }
            if (runningY >= (int)SSD1306_HEIGHT) return;

            char ch = text[i];
            if (ch >= 'a' && ch <= 'z') {
                ch -= 32;
            }
            draw_char_5x7(runningX, runningY, ch);
            runningX += 6;
        }
    }
}
